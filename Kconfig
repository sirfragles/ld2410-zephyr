## Kconfig
```kconfig
# Copyright (c) 2024 Matthew Macdonald-Wallace
# SPDX-License-Identifier: Apache-2.0

rsource "drivers/sensor/ld2410/Kconfig"
```

## drivers/sensor/ld2410/Kconfig
```kconfig
# Copyright (c) 2024 Matthew Macdonald-Wallace
# SPDX-License-Identifier: Apache-2.0

menuconfig LD2410
	bool "LD2410 24GHz mmWave Presence Sensor"
	default y
	depends on SERIAL
	depends on UART_INTERRUPT_DRIVEN
	depends on RING_BUFFER
	help
	  Enable driver for HiLink LD2410 family 24GHz mmWave human
	  presence sensors (LD2410, LD2410B, LD2410C).

if LD2410

config LD2410_RX_BUF_SIZE
	int "UART receive ring buffer size"
	default 256
	help
	  Size of the UART receive ring buffer in bytes.

config LD2410_CMD_TIMEOUT_MS
	int "Command ACK response timeout (ms)"
	default 1000
	help
	  Timeout in milliseconds for ACK responses from
	  configuration commands.

config LD2410_THREAD_STACK_SIZE
	int "RX processing thread stack size"
	default 1024
	help
	  Stack size for the UART receive processing thread.

config LD2410_THREAD_PRIORITY
	int "RX processing thread priority"
	default 5
	help
	  Cooperative priority for the RX processing thread.

config LD2410_INIT_PRIORITY
	int "Driver initialization priority"
	default 90
	help
	  Initialization priority for the LD2410 driver.
	  Must be higher than SERIAL_INIT_PRIORITY.

module = LD2410
module-str = ld2410
source "subsys/logging/Kconfig.template.log_config"

endif # LD2410
```

## dts/bindings/sensor/hilink,ld2410.yaml
```yaml
# Copyright (c) 2024 Matthew Macdonald-Wallace
# SPDX-License-Identifier: Apache-2.0

description: |
  HiLink LD2410 24GHz FMCW mmWave human presence sensor.
  Supports LD2410, LD2410B, and LD2410C variants.

  The sensor communicates over UART and must be declared as a
  child node of a UART peripheral node.

compatible: "hilink,ld2410"

include:
  - uart-device.yaml

properties:
  out-gpios:
    type: phandle-array
    description: |
      Optional GPIO connected to the sensor OUT pin for hardware
      presence detection. When specified, the driver automatically
      configures this GPIO as an input during initialization.

examples:
  - |
    &uart1 {
            current-speed = <256000>;
            ld2410: ld2410 {
                    compatible = "hilink,ld2410";
                    out-gpios = <&gpio0 26 GPIO_ACTIVE_HIGH>;
            };
    };
```

## tests/protocol/testcase.yaml
```yaml
tests:
  drivers.sensor.ld2410.protocol:
    tags: drivers sensor
    platform_allow: native_sim native_sim/native/64
```
